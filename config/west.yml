## config/west.yml
```yaml
manifest:
  remotes:
    - name: zmkfirmware
      url-base: https://github.com/zmkfirmware
    - name: badjeff
      url-base: https://github.com/badjeff
    - name: hsgw
      url-base: https://github.com/hsgw
    - name: caksoylar  # <-- led
      url-base: https://github.com/caksoylar  

  projects:
    # 💡 ZMK 本体を最新（main）へアップデート
    - name: zmk
      remote: zmkfirmware
      revision: main
      import: app/west.yml

    # 💡 PMW3610 ドライバも最新（main）へアップデート（これによって最新ZMKと互換性を持ちます）
    - name: zmk-pmw3610-driver
      remote: badjeff
      revision: main
    
    # Sensor-rotation（そのまま維持）
    - name: zmk-feature-sensor_rotation
      remote: hsgw
      revision: main

    # 💡 LEDウィジェットも最新（main）へアップデート
    - name: zmk-rgbled-widget  # <-- led
      remote: caksoylar
      revision: main
      
  self:
    path: config
```
